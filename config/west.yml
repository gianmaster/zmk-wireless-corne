## config/west.yml
```yaml
manifest:
  remotes:
      # zmk official
    - name: zmkfirmware
      url-base: https://github.com/zmkfirmware
    - name: gianmaster                         #new entry
      url-base: https://github.com/gianmaster  #new entry
  projects:
    - name: zmk
      remote: zmkfirmware
      revision: main
      import: app/west.yml
    - name: niceview-slideshow          #new entry
      remote: gianmaster                       #new entry
      revision: main                      #new entry
  self:
    path: config
```
